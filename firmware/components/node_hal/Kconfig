## firmware/components/node_hal/Kconfig
```kconfig
menu "Node HAL"

    config NODE_HAL_SELFTEST
        bool "Run the HAL hardware self-test at boot"
        default n
        help
            Scans the I2C bus and logs the addresses that answer, logs every
            edge on the button pin, and toggles an output pin. For checking
            wiring on a real board; leave disabled otherwise.

    config NODE_HAL_SELFTEST_I2C_SDA
        int "I2C SDA GPIO"
        depends on NODE_HAL_SELFTEST
        range 0 39
        default 32

    config NODE_HAL_SELFTEST_I2C_SCL
        int "I2C SCL GPIO"
        depends on NODE_HAL_SELFTEST
        range 0 39
        default 33

    config NODE_HAL_SELFTEST_BUTTON_GPIO
        int "Button GPIO whose edges are logged"
        depends on NODE_HAL_SELFTEST
        range 0 39
        default 0
        help
            GPIO 0 is the DevKitC BOOT button.

    config NODE_HAL_SELFTEST_OUTPUT_GPIO
        int "Output GPIO to toggle (-1 for none)"
        depends on NODE_HAL_SELFTEST
        range -1 39
        default -1

endmenu
```

## firmware/components/node_health/Kconfig
```kconfig
menu "Node health"

    config NODE_HEALTH_DEBUG_HANG
        bool "Hang the health AO 15 s after boot (debug)"
        default n
        help
            For testing the task watchdog only. 15 s after boot the health
            AO's dispatch never returns, so its thread stops feeding the
            task watchdog, which resets the node; the next boot logs
            reset_reason=task_wdt. Never enable it in sdkconfig.defaults or
            sdkconfig.qemu.

endmenu
```

## firmware/main/Kconfig.projbuild
```kconfig
menu "Mesh node"

    config NODE_MESH_ENABLE
        bool "Enable BLE mesh"
        depends on BLE_MESH
        default y
        help
            Start the BLE mesh node at boot. Disabled in the QEMU build,
            because QEMU does not emulate Bluetooth.

endmenu
```
